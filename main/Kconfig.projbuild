## main/Kconfig.projbuild
```kconfig
menu "Mota Sensora Configuration"
	config PIN_DHT11
		int "DHT11 GPIO Number"
		range 0 48
		default 5
		help
			GPIO number for DHT11 Sensor

	config WRITE_API_KEY
		string "Write API Key"
		default ""
		help
			Thingspeak's API Key that you can get in the webpage

endmenu
```
